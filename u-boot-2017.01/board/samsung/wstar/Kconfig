## u-boot-2017.01/board/samsung/wstar/Kconfig
```kconfig
#这个是等下make menuconfig 指定的一个宏
if TARGET_WSTAR  

#指定你的board 文件夹的名称
config SYS_BOARD
	default "wstar"

config SYS_VENDOR
	default "samsung"
	
#指定你的芯片的类型
config SYS_SOC
	default "s5pc1xx"

#指定你的 include/configs/wstar.h 为配置头文件
config SYS_CONFIG_NAME
	default "wstar"

endif
```

## u-boot-2017.01/configs/wstar_defconfig
```kconfig
CONFIG_ARM=y
CONFIG_ARCH_S5PC1XX=y
CONFIG_TARGET_WSTAR=y
CONFIG_IDENT_STRING=" for WSTAR"
# CONFIG_MMC is not set
CONFIG_DEFAULT_DEVICE_TREE="s5pc1xx-smdkc100"
CONFIG_BOOTDELAY=3
CONFIG_HUSH_PARSER=y
CONFIG_SYS_PROMPT="WSTAR # "
# CONFIG_CMD_IMLS is not set
# CONFIG_CMD_FLASH is not set
# CONFIG_CMD_SETEXPR is not set
CONFIG_CMD_CACHE=y
CONFIG_CMD_FAT=y
```
